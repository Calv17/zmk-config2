## boards/shields/corne/Kconfig.defconfig
```kconfig
if SHIELD_CORNE_DONGLE

config ZMK_KEYBOARD_NAME
    default "Corne"

config ZMK_SPLIT_ROLE_CENTRAL
    default y

config ZMK_SPLIT
    default y

endif

if SHIELD_CORNE_LEFT || SHIELD_CORNE_RIGHT

config ZMK_SPLIT
    default y

config ZMK_PM_SOFT_OFF
    default y

endif
```
