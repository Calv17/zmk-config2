/*
 * Copyright (c) 2020 Pete Johanson
 *
 * SPDX-License-Identifier: MIT
 */


#include "corne.dtsi"

/ {

    physical_layout0: physical_layout_0 {
        compatible = "zmk,physical-layout";
        display-name = "Default layout";
        transform = <&default_transform>;
    };

    chosen {
        zmk,kscan = &mock_kscan;
        zmk,physical-layout = &physical_layout0;
    };

    mock_kscan: kscan_0 {
        compatible = "zmk,kscan-mock";
        columns = <0>;
        rows = <0>;
        events = <0>;

    };

};