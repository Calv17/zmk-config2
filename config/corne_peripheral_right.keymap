/*
 * Copyright (c) 2020 The ZMK Contributors
 *
 * SPDX-License-Identifier: MIT
 */

#include <behaviors.dtsi>
#include <dt-bindings/zmk/keys.h>

&nice_view_spi {
       cs-gpios = <&pro_micro 4 GPIO_ACTIVE_HIGH>;
   };

